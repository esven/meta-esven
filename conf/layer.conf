## conf/layer.conf
```bitbake
# We have a conf and classes directory, append to BBPATH
BBPATH .= ":${LAYERDIR}"

# We have a recipes directory, add to BBFILES
BBFILES += "${LAYERDIR}/recipes*/*/*.bb ${LAYERDIR}/recipes*/*/*.bbappend"

BBFILE_COLLECTIONS += "esven"
BBFILE_PATTERN_esven := "^${LAYERDIR}/"
BBFILE_PRIORITY_esven = "7"
```

## conf/machine/panda-es.conf
```bitbake
#@TYPE: Machine
#@NAME: Pandaboard ES
#@DESCRIPTION: Machine configuration for the OMAP4460 Panda ES

require conf/machine/include/soc-family.inc
require conf/machine/include/tune-cortexa9.inc

SOC_FAMILY = "omap4"

GUI_MACHINE_CLASS = "bigscreen"

IMAGE_FSTYPES += "tar.gz"

SERIAL_CONSOLE = "115200 ttyO2"

MACHINE_EXTRA_RRECOMMENDS = " kernel-modules"
MACHINE_FEATURES = "wifi bluetooth alsa apm ext2 screen usbgadget usbhost vfat sgx"

KERNEL_DEVICETREE = "omap4-panda-es.dtb"

PREFERRED_PROVIDER_virtual/kernel = "linux-mainline"
PREFERRED_PROVIDER_virtual/bootloader = "u-boot"

PREFERRED_PROVIDER_virtual/xserver = "xserver-xorg"
XSERVER = "xserver-xorg \
           xserver-xorg-module-exa \
           xf86-input-evdev \
           xf86-video-omap"

# Increase this everytime you change something in the kernel
MACHINE_KERNEL_PR = "r1"

KERNEL_IMAGETYPE = "zImage"

UBOOT_MACHINE = "omap4_panda_config"

UBOOT_ENTRYPOINT = "0x80008000"
UBOOT_LOADADDRESS = "0x80008000"

EXTRA_IMAGEDEPENDS += "u-boot"
```
